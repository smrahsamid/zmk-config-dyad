## boards/shields/dyad/Kconfig.defconfig
```kconfig
if SHIELD_DYAD_DONGLE

config ZMK_KEYBOARD_NAME
    default "Dyad Keyboard"

config ZMK_SPLIT_ROLE_CENTRAL
    default y

config ZMK_SPLIT
    default y

config ZMK_SPLIT_BLE_CENTRAL_PERIPHERALS
    default 1

config BT_MAX_CONN
    default 6

config BT_MAX_PAIRED
    default 6

endif

if SHIELD_DYAD_LEFT || SHIELD_DYAD_RIGHT

config ZMK_SPLIT
    default y

endif
```

## config/boards/shields/dyad/Kconfig.defconfig
```kconfig
if SHIELD_DYAD_CENTRAL_DONGLE || SHIELD_DYAD_CENTRAL_LEFT

config ZMK_KEYBOARD_NAME
    default "DYAD"

config ZMK_SPLIT_ROLE_CENTRAL
    default y

endif

if SHIELD_DYAD_CENTRAL_DONGLE || SHIELD_DYAD_CENTRAL_LEFT || SHIELD_DYAD_PERIPHERAL_LEFT || SHIELD_DYAD_PERIPHERAL_RIGHT

config ZMK_SPLIT
    default y

endif
```

## config/boards/shields/dyad/Kconfig.shield
```kconfig
config SHIELD_DYAD_LEFT
    def_bool $(shields_list_contains,dyad_left)

config SHIELD_DYAD_RIGHT
    def_bool $(shields_list_contains,dyad_right)

config SHIELD_DYAD_DONGLE
    def_bool $(shields_list_contains,dyad_dongle)
```
